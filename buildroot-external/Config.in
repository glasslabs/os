## buildroot-external/Config.in
```kconfig
source "$BR2_EXTERNAL_GLASSOS_PATH/package/glass/Config.in"
source "$BR2_EXTERNAL_GLASSOS_PATH/package/glassos-supervisor/Config.in"
```

## buildroot-external/configs/glassos_rpi4_defconfig
```kconfig
BR2_aarch64=y
BR2_cortex_a72=y
BR2_TOOLCHAIN_BUILDROOT_GLIBC=y
BR2_TOOLCHAIN_BUILDROOT_CXX=y
BR2_SSP_REGULAR=y
BR2_TARGET_GENERIC_HOSTNAME="glass"
BR2_TARGET_GENERIC_ISSUE="GlassOS"
BR2_TARGET_GENERIC_ROOT_PASSWD="glass"
BR2_INIT_SYSTEMD=y
# BR2_TARGET_GENERIC_REMOUNT_ROOTFS_RW is not set
BR2_ROOTFS_OVERLAY="$(BR2_EXTERNAL_GLASSOS_PATH)/rootfs-overlay"
BR2_ROOTFS_POST_BUILD_SCRIPT="$(BR2_EXTERNAL_GLASSOS_PATH)/scripts/post-build.sh"
BR2_ROOTFS_POST_IMAGE_SCRIPT="$(BR2_EXTERNAL_GLASSOS_PATH)/scripts/post-image.sh"
BR2_ROOTFS_POST_SCRIPT_ARGS="$(BR2_EXTERNAL_GLASSOS_PATH)/board/rpi4 $(BR2_EXTERNAL_GLASSOS_PATH)/board/glassos-hook.sh"
BR2_LINUX_KERNEL=y
BR2_LINUX_KERNEL_CUSTOM_TARBALL=y
BR2_LINUX_KERNEL_CUSTOM_TARBALL_LOCATION="https://github.com/raspberrypi/linux/archive/89050b1059997d38d55462b323b099a6436dc10d.tar.gz"
BR2_LINUX_KERNEL_DEFCONFIG="bcm2711"
BR2_LINUX_KERNEL_CONFIG_FRAGMENT_FILES="$(BR2_EXTERNAL_GLASSOS_PATH)/kernel/common.config $(BR2_EXTERNAL_GLASSOS_PATH)/board/rpi4/linux.config"
BR2_LINUX_KERNEL_LZ4=y
BR2_LINUX_KERNEL_DTS_SUPPORT=y
BR2_LINUX_KERNEL_INTREE_DTS_NAME="broadcom/bcm2711-rpi-4-b broadcom/bcm2711-rpi-cm4"
BR2_LINUX_KERNEL_NEEDS_HOST_OPENSSL=y
BR2_LINUX_KERNEL_NEEDS_HOST_LIBELF=y
BR2_PACKAGE_RPI_FIRMWARE=y
BR2_PACKAGE_RPI_FIRMWARE_VARIANT_PI4=y
BR2_PACKAGE_RPI_FIRMWARE_VARIANT_PI4_X=y
BR2_PACKAGE_RPI_FIRMWARE_VARIANT_PI4_CD=y
BR2_PACKAGE_BRCMFMAC_SDIO_FIRMWARE_RPI=y
BR2_PACKAGE_BRCMFMAC_SDIO_FIRMWARE_RPI_BT=y
BR2_PACKAGE_BRCMFMAC_SDIO_FIRMWARE_RPI_WIFI=y
BR2_PACKAGE_MESA3D=y
BR2_PACKAGE_MESA3D_GBM=y
BR2_PACKAGE_MESA3D_OPENGL_ES=y
BR2_PACKAGE_MESA3D_GALLIUM_DRIVER_VC4=y
BR2_PACKAGE_MESA3D_GALLIUM_DRIVER_V3D=y
BR2_PACKAGE_LIBDRM=y
BR2_PACKAGE_LIBXKBCOMMON=y
BR2_PACKAGE_WAYLAND=y
BR2_PACKAGE_WAYLAND_PROTOCOLS=y
BR2_PACKAGE_CAGE=y
BR2_PACKAGE_JQ=y
BR2_PACKAGE_UTIL_LINUX=y
BR2_PACKAGE_UTIL_LINUX_BINARIES=y
BR2_PACKAGE_UTIL_LINUX_PARTX=y
BR2_PACKAGE_E2FSPROGS=y
BR2_PACKAGE_DOSFSTOOLS=y
BR2_PACKAGE_DOSFSTOOLS_FSCK_FAT=y
BR2_TARGET_UBOOT=y
BR2_TARGET_UBOOT_BUILD_SYSTEM_KCONFIG=y
BR2_TARGET_UBOOT_CUSTOM_VERSION=y
BR2_TARGET_UBOOT_CUSTOM_VERSION_VALUE="2025.07"
BR2_TARGET_UBOOT_BOARD_DEFCONFIG="rpi_4"
BR2_TARGET_UBOOT_CONFIG_FRAGMENT_FILES="$(BR2_EXTERNAL_GLASSOS_PATH)/board/uboot.config"
BR2_TARGET_UBOOT_NEEDS_DTC=y
BR2_PACKAGE_LIBUBOOTENV=y
BR2_PACKAGE_HOST_UBOOT_TOOLS=y
BR2_PACKAGE_HOST_UBOOT_TOOLS_BOOT_SCRIPT=y
BR2_PACKAGE_HOST_UBOOT_TOOLS_BOOT_SCRIPT_SOURCE="$(BR2_EXTERNAL_GLASSOS_PATH)/board/rpi4/uboot-boot.ush"
BR2_PACKAGE_RAUC=y
BR2_PACKAGE_RAUC_DBUS=y
BR2_PACKAGE_RAUC_NETWORK=y
BR2_PACKAGE_NETWORK_MANAGER=y
BR2_PACKAGE_NETWORK_MANAGER_CLI=y
BR2_PACKAGE_WIRELESS_REGDB=y
BR2_PACKAGE_WPA_SUPPLICANT=y
BR2_PACKAGE_WPA_SUPPLICANT_WEXT=y
BR2_PACKAGE_WPA_SUPPLICANT_AP_SUPPORT=y
BR2_PACKAGE_WPA_SUPPLICANT_WPA3=y
BR2_PACKAGE_WPA_SUPPLICANT_DBUS=y
BR2_PACKAGE_WPA_SUPPLICANT_DBUS_INTROSPECTION=y
BR2_PACKAGE_DROPBEAR=y
BR2_PACKAGE_DROPBEAR_DISABLE_REVERSEDNS=y
BR2_PACKAGE_GLASS=y
BR2_PACKAGE_GLASS_VERSION="v2.0.0"
BR2_PACKAGE_GLASS_AGENT=y
BR2_TARGET_ROOTFS_EROFS=y
BR2_TARGET_ROOTFS_EROFS_LZ4HC_LEVEL=12
BR2_TARGET_ROOTFS_EROFS_DEDUPE=y
BR2_TARGET_ROOTFS_EROFS_FRAGMENTS=y
BR2_TARGET_ROOTFS_EROFS_ZTAILPACKING=y
BR2_TARGET_ROOTFS_EROFS_PCLUSTERSIZE=262144
# BR2_TARGET_ROOTFS_TAR is not set
BR2_PACKAGE_HOST_DOSFSTOOLS=y
BR2_PACKAGE_HOST_E2FSPROGS=y
BR2_PACKAGE_HOST_GENIMAGE=y
BR2_PACKAGE_HOST_MTOOLS=y
BR2_PACKAGE_HOST_RAUC=y
```

## buildroot-external/configs/glassos_rpi5_defconfig
```kconfig
BR2_aarch64=y
BR2_cortex_a76=y
BR2_TOOLCHAIN_BUILDROOT_GLIBC=y
BR2_TOOLCHAIN_BUILDROOT_CXX=y
BR2_SSP_REGULAR=y
BR2_TARGET_GENERIC_HOSTNAME="glass"
BR2_TARGET_GENERIC_ISSUE="GlassOS"
BR2_TARGET_GENERIC_ROOT_PASSWD="glass"
BR2_INIT_SYSTEMD=y
BR2_LINUX_KERNEL=y
BR2_LINUX_KERNEL_CUSTOM_GIT=y
BR2_LINUX_KERNEL_CUSTOM_REPO_URL="https://github.com/raspberrypi/linux"
BR2_LINUX_KERNEL_CUSTOM_REPO_VERSION="rpi-6.12.y"
BR2_LINUX_KERNEL_DEFCONFIG="bcm2712"
BR2_LINUX_KERNEL_CONFIG_FRAGMENT_FILES="$(BR2_EXTERNAL_GLASSOS_PATH)/kernel/common.config $(BR2_EXTERNAL_GLASSOS_PATH)/board/rpi5/linux.config"
BR2_LINUX_KERNEL_NEEDS_HOST_OPENSSL=y
BR2_LINUX_KERNEL_INSTALL_TARGET=y
BR2_PACKAGE_RPI_FIRMWARE=y
BR2_PACKAGE_RPI_FIRMWARE_INSTALL_DTB_OVERLAYS=y
BR2_PACKAGE_MESA3D=y
BR2_PACKAGE_MESA3D_GBM=y
BR2_PACKAGE_MESA3D_OPENGL_ES=y
BR2_PACKAGE_MESA3D_GALLIUM_DRIVER_VC4=y
BR2_PACKAGE_MESA3D_GALLIUM_DRIVER_V3D=y
BR2_PACKAGE_LIBDRM=y
BR2_PACKAGE_LIBXKBCOMMON=y
BR2_PACKAGE_WAYLAND=y
BR2_PACKAGE_WAYLAND_PROTOCOLS=y
BR2_PACKAGE_CAGE=y
BR2_TARGET_UBOOT=y
BR2_TARGET_UBOOT_BUILD_SYSTEM_KCONFIG=y
BR2_TARGET_UBOOT_BOARD_DEFCONFIG="rpi_5"
BR2_TARGET_UBOOT_NEEDS_DTC=y
BR2_PACKAGE_LIBUBOOTENV=y
BR2_PACKAGE_RAUC=y
BR2_PACKAGE_NETWORKMANAGER=y
BR2_PACKAGE_NETWORKMANAGER_WIFI=y
BR2_PACKAGE_WPA_SUPPLICANT=y
BR2_PACKAGE_DROPBEAR=y
BR2_PACKAGE_GLASS=y
BR2_PACKAGE_GLASS_VERSION="v2.0.0"
BR2_PACKAGE_GLASS_AGENT=y
BR2_ROOTFS_OVERLAY="$(BR2_EXTERNAL_GLASSOS_PATH)/rootfs-overlay"
BR2_ROOTFS_POST_BUILD_SCRIPT="$(BR2_EXTERNAL_GLASSOS_PATH)/board/rpi5/post-build.sh"
BR2_ROOTFS_POST_IMAGE_SCRIPT="$(BR2_EXTERNAL_GLASSOS_PATH)/board/rpi5/post-image.sh"
BR2_TARGET_ROOTFS_EXT2=y
BR2_TARGET_ROOTFS_EXT2_4=y
BR2_TARGET_ROOTFS_EXT2_SIZE="1024M"
```

## buildroot-external/configs/rpi4_defconfig
```kconfig
# Architecture & toolchain
BR2_aarch64=y
BR2_cortex_a72=y
BR2_TOOLCHAIN_BUILDROOT_CXX=y
BR2_TOOLCHAIN_BUILDROOT_WCHAR=y
BR2_TOOLCHAIN_BUILDROOT_LOCALE=y

# Build settings
BR2_SSP_REGULAR=y
BR2_ENABLE_LTO=y
BR2_USE_WCHAR=y

# Generic system
BR2_TARGET_GENERIC_HOSTNAME="glass"
BR2_TARGET_GENERIC_ISSUE="GlassOS"
BR2_TARGET_GENERIC_ROOT_PASSWD="glass"
BR2_INIT_SYSTEMD=y
# BR2_TARGET_GENERIC_REMOUNT_ROOTFS_RW is not set

# Filesystem overlays & scripts
BR2_ROOTFS_OVERLAY="$(BR2_EXTERNAL_GLASSOS_PATH)/rootfs-overlay"
BR2_ROOTFS_POST_BUILD_SCRIPT="$(BR2_EXTERNAL_GLASSOS_PATH)/scripts/post-build.sh"
BR2_ROOTFS_POST_IMAGE_SCRIPT="$(BR2_EXTERNAL_GLASSOS_PATH)/scripts/post-image.sh"
BR2_ROOTFS_POST_SCRIPT_ARGS="$(BR2_EXTERNAL_GLASSOS_PATH)/board/rpi4 $(BR2_EXTERNAL_GLASSOS_PATH)/board/glassos-hook.sh"

# Kernel
BR2_LINUX_KERNEL=y
BR2_LINUX_KERNEL_CUSTOM_TARBALL=y
BR2_LINUX_KERNEL_CUSTOM_TARBALL_LOCATION="https://github.com/raspberrypi/linux/archive/c8c7494100e99ee05b11aaa4f0588a223a63d1af.tar.gz"
BR2_LINUX_KERNEL_DEFCONFIG="bcm2711"
BR2_LINUX_KERNEL_CONFIG_FRAGMENT_FILES="$(BR2_EXTERNAL_GLASSOS_PATH)/kernel/common.config $(BR2_EXTERNAL_GLASSOS_PATH)/board/rpi4/linux.config"
BR2_LINUX_KERNEL_LZ4=y
BR2_LINUX_KERNEL_DTS_SUPPORT=y
BR2_LINUX_KERNEL_INTREE_DTS_NAME="broadcom/bcm2711-rpi-4-b broadcom/bcm2711-rpi-cm4"
BR2_LINUX_KERNEL_NEEDS_HOST_OPENSSL=y
BR2_LINUX_KERNEL_NEEDS_HOST_LIBELF=y
BR2_PACKAGE_HOST_LINUX_HEADERS_CUSTOM_6_18=y

# Bootloader
BR2_TARGET_UBOOT=y
BR2_TARGET_UBOOT_BUILD_SYSTEM_KCONFIG=y
BR2_TARGET_UBOOT_CUSTOM_VERSION=y
BR2_TARGET_UBOOT_CUSTOM_VERSION_VALUE="2026.04"
BR2_TARGET_UBOOT_BOARD_DEFCONFIG="rpi_4"
BR2_TARGET_UBOOT_CONFIG_FRAGMENT_FILES="$(BR2_EXTERNAL_GLASSOS_PATH)/board/uboot.config"
BR2_TARGET_UBOOT_NEEDS_DTC=y

# Hardware & firmware
BR2_PACKAGE_RPI_FIRMWARE=y
BR2_PACKAGE_RPI_FIRMWARE_VERSION=89752d47a688ec33c9f0c38f6549f627e5c143f9
BR2_PACKAGE_RPI_FIRMWARE_VARIANT_PI4=y
BR2_PACKAGE_RPI_FIRMWARE_VARIANT_PI4_X=y
BR2_PACKAGE_RPI_FIRMWARE_VARIANT_PI4_CD=y
BR2_PACKAGE_BRCMFMAC_SDIO_FIRMWARE_RPI=y
BR2_PACKAGE_BRCMFMAC_SDIO_FIRMWARE_RPI_BT=y
BR2_PACKAGE_BRCMFMAC_SDIO_FIRMWARE_RPI_WIFI=y

# Graphics & display
BR2_PACKAGE_LIBDRM=y
BR2_PACKAGE_MESA3D=y
BR2_PACKAGE_MESA3D_GBM=y
BR2_PACKAGE_MESA3D_OPENGL_ES=y
BR2_PACKAGE_MESA3D_GALLIUM_DRIVER_VC4=y
BR2_PACKAGE_MESA3D_GALLIUM_DRIVER_V3D=y
BR2_PACKAGE_WAYLAND=y
BR2_PACKAGE_WAYLAND_PROTOCOLS=y
BR2_PACKAGE_CAGE=y
BR2_PACKAGE_LIBXKBCOMMON=y
BR2_PACKAGE_XKEYBOARD_CONFIG=y
BR2_ENABLE_LOCALE=y
BR2_ENABLE_LOCALE_PURGE=y
BR2_ENABLE_LOCALE_WHITELIST="C C.UTF-8 en_US en_US.UTF-8"
BR2_GENERATE_LOCALE="en_US.UTF-8"

# System tools
BR2_PACKAGE_DOSFSTOOLS=y
BR2_PACKAGE_E2FSPROGS=y
BR2_PACKAGE_IPROUTE2=y
BR2_PACKAGE_JQ=y
BR2_PACKAGE_UTIL_LINUX=y
BR2_PACKAGE_UTIL_LINUX_BINARIES=y
BR2_PACKAGE_UTIL_LINUX_NOLOGIN=y
BR2_PACKAGE_UTIL_LINUX_PARTX=y

# OTA & update
BR2_PACKAGE_LIBUBOOTENV=y
BR2_PACKAGE_RAUC=y
BR2_PACKAGE_RAUC_DBUS=y
BR2_PACKAGE_RAUC_NETWORK=y

# Networking
BR2_PACKAGE_DNSMASQ=y
BR2_PACKAGE_NETWORK_MANAGER=y
BR2_PACKAGE_NETWORK_MANAGER_CLI=y
BR2_PACKAGE_WIRELESS_REGDB=y
BR2_PACKAGE_WPA_SUPPLICANT=y
BR2_PACKAGE_WPA_SUPPLICANT_WEXT=y
BR2_PACKAGE_WPA_SUPPLICANT_AP_SUPPORT=y
BR2_PACKAGE_WPA_SUPPLICANT_WPA3=y
BR2_PACKAGE_WPA_SUPPLICANT_DBUS=y
BR2_PACKAGE_WPA_SUPPLICANT_DBUS_INTROSPECTION=y

# Remote access
BR2_PACKAGE_DROPBEAR=y
BR2_PACKAGE_DROPBEAR_DISABLE_REVERSEDNS=y

# Systemd options
# BR2_PACKAGE_SYSTEMD_HWDB is not set
BR2_PACKAGE_SYSTEMD_LOCALED=y
BR2_PACKAGE_SYSTEMD_LOGIND=y
BR2_PACKAGE_SYSTEMD_RANDOMSEED=y

# Application
BR2_PACKAGE_GLASS=y
BR2_PACKAGE_GLASS_VERSION="v2.0.5"
BR2_PACKAGE_GLASSOS_SUPERVISOR=y
BR2_PACKAGE_GLASSOS_SUPERVISOR_VERSION="v0.1.1"

# Root filesystem
BR2_TARGET_ROOTFS_EROFS=y
BR2_TARGET_ROOTFS_EROFS_LZ4HC_LEVEL=12
BR2_TARGET_ROOTFS_EROFS_DEDUPE=y
BR2_TARGET_ROOTFS_EROFS_FRAGMENTS=y
BR2_TARGET_ROOTFS_EROFS_ZTAILPACKING=y
BR2_TARGET_ROOTFS_EROFS_PCLUSTERSIZE=262144
# BR2_TARGET_ROOTFS_TAR is not set

# Host tools
BR2_PACKAGE_HOST_DOSFSTOOLS=y
BR2_PACKAGE_HOST_E2FSPROGS=y
BR2_PACKAGE_HOST_GENIMAGE=y
BR2_PACKAGE_HOST_MTOOLS=y
BR2_PACKAGE_HOST_RAUC=y
BR2_PACKAGE_HOST_UBOOT_TOOLS=y
BR2_PACKAGE_HOST_UBOOT_TOOLS_BOOT_SCRIPT=y
BR2_PACKAGE_HOST_UBOOT_TOOLS_BOOT_SCRIPT_SOURCE="$(BR2_EXTERNAL_GLASSOS_PATH)/board/rpi4/uboot-boot.ush"

# Certificates
BR2_PACKAGE_CA_CERTIFICATES=y
```

## buildroot-external/package/glass-agent/Config.in
```kconfig
config BR2_PACKAGE_GLASS_AGENT
	bool "glass-agent"
	help
	  GlassOS management agent. Supervises the glass process and provides
	  an HTTP API for OTA updates, log access, WiFi configuration, and
	  config/asset/module uploads.
```

## buildroot-external/package/glass/Config.in
```kconfig
config BR2_PACKAGE_GLASS
	bool "glass"
	help
	  Looking Glass smart mirror binary, downloaded from GitHub Releases.

if BR2_PACKAGE_GLASS

config BR2_PACKAGE_GLASS_VERSION
	string "glass version"
	default "v0.0.0"
	help
	  The looking-glass release tag to download (e.g. v1.0.0).
	  Must match GLASS_VERSION in the top-level Makefile.

config BR2_PACKAGE_GLASS_VARIANT
	string "glass variant"
	default "wayland"
	help
	  The Gio window-system backend variant to use. Must match GLASS_VARIANT
	  in the top-level Makefile and the suffix of the downloaded release archive.
	  Choices: wayland (no X11 dep), x11, full (both backends).

endif
```

## buildroot-external/package/glassos-supervisor/Config.in
```kconfig
config BR2_PACKAGE_GLASSOS_SUPERVISOR
	bool "supervisor"
	help
	  GlassOS supervisor. Supervises the glass process and provides
	  an HTTP API for OTA updates, log access, and
	  config/asset/module uploads.

if BR2_PACKAGE_GLASSOS_SUPERVISOR

config BR2_PACKAGE_GLASSOS_SUPERVISOR_VERSION
	string "supervisor version"
	default "v0.0.0"
	help
	  The supervisor release tag to download (e.g. v1.0.0).
	  Must match SUPERVISOR_VERSION in the top-level Makefile.

endif
```
